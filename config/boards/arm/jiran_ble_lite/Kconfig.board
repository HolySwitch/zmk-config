## config/boards/arm/jiran_ble_lite/Kconfig.board
```kconfig
# Jiran BLE Lite board configuration

# Copyright (c) 2021 The ZMK Contributors
# SPDX-License-Identifier: MIT

config BOARD_JIRAN_BLE_LITE_LEFT
	bool "jiran_ble_lite_left"
	depends on SOC_NRF52840_QIAA

config BOARD_JIRAN_BLE_LITE_RIGHT
	bool "jiran_ble_lite_right"
	depends on SOC_NRF52840_QIAA
```

## config/boards/arm/jiran_ble_lite/Kconfig.defconfig
```kconfig
# Copyright (c) 2021 The ZMK Contributors
# SPDX-License-Identifier: MIT

if BOARD_JIRAN_BLE_LITE_LEFT

	config ZMK_KEYBOARD_NAME
	default "Jiran BLE Lite"

endif # BOARD_JIRAN_BLE_LITE_LEFT


if BOARD_JIRAN_BLE_LITE_LEFT || BOARD_JIRAN_BLE_LITE_RIGHT

config BOARD
	default "jiran_ble_lite"

config ZMK_SPLIT
	default y

menuconfig SENSOR
    bool "Sensor Drivers"

config BT_CTLR
	default BT

config ZMK_BLE
	default y

config ZMK_USB
	default y

if USB

config USB_NRFX
	default y

config USB_DEVICE_STACK
	default y

endif # USB

endif # BOARD_JIRAN_BLE_LITE_LEFT || BOARD_JIRAN_BLE_LITE_RIGHT
```

## config/boards/arm/mriya/Kconfig.board
```kconfig
# Copyright (c) 2023 Andrei Gaevkii
# SPDX-License-Identifier: MIT

config BOARD_MRIYA_LEFT
	bool "mriya_left"
	depends on SOC_NRF52840_QIAA

config BOARD_MRIYA_RIGHT
	bool "mriya_right"
	depends on SOC_NRF52840_QIAA
```

## config/boards/arm/mriya/Kconfig.defconfig
```kconfig
# Copyright (c) 2023 Andrei Gaevkii
# SPDX-License-Identifier: MIT

if BOARD_MRIYA_LEFT

	config ZMK_KEYBOARD_NAME
	default "Mriya"

    config ZMK_SPLIT_BLE_ROLE_CENTRAL
	default y

endif # BOARD_MRIYA_LEFT

if BOARD_MRIYA_RIGHT

	config ZMK_KEYBOARD_NAME
	default "Mriya Right"

endif # BOARD_MRIYA_RIGHT


if BOARD_MRIYA_LEFT || BOARD_MRIYA_RIGHT

config BOARD
	default "mriya"

config ZMK_SPLIT
	default y

config BT_CTLR
	default BT

config ZMK_BATTERY_VOLTAGE_DIVIDER
	default y

if USB

config USB_NRFX
	default y

config USB_DEVICE_STACK
	default y

endif # USB

endif # BOARD_MRIYA_LEFT || BOARD_MRIYA_RIGHT
```

## config/boards/arm/tk44/Kconfig.board
```kconfig
# Jorian840 board configuration

# Copyright (c) 2022 The ZMK Contributors
# SPDX-License-Identifier: MIT

config BOARD_TK44
	bool "tk44"
	depends on SOC_NRF52840_QIAA
```
